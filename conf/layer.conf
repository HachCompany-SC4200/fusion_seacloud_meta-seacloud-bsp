## conf/layer.conf
```bitbake
# We have a conf and classes directory, append to BBPATH
BBPATH .= ":${LAYERDIR}"

# We have a recipes directory, add to BBFILES
BBFILES += "${LAYERDIR}/recipes*/*/*.bb \
	    ${LAYERDIR}/recipes*/*/*.bbappend"

BBFILE_COLLECTIONS += "meta-seacloud-bsp"
BBFILE_PATTERN_meta-seacloud-bsp := "^${LAYERDIR}/"
BBFILE_PRIORITY_meta-seacloud-bsp = "92"
LAYERVERSION_meta-seacloud-bsp = "1"
```
